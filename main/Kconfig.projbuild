## main/Kconfig.projbuild
```kconfig
menu "Example Configuration"

    config EXAMPLE_BASIC_AUTH
        bool "Basic Authentication"
        default n
        help
            Basic Authentication is a method for an HTTP user agent (e.g. a web browser)
            to provide a user name and password when making a request. It is the simplest
            technique for enforcing access controls to web resources. because it doesn't
            require cookies, session identifiers, or login pages; rather, it uses standard
            fields in the HTTP header.
            Note that, Basic Authentication is not encrypted channel and also easy to retrieve
            credentials as they are sent in plain text format.

    config EXAMPLE_BASIC_AUTH_USERNAME
        string "Basic Authenticate User Name"
        depends on EXAMPLE_BASIC_AUTH
        default "ESP32"
        help
            The client's user name which used for basic authenticate.

    config EXAMPLE_BASIC_AUTH_PASSWORD
        string "Basic Authenticate Password"
        depends on EXAMPLE_BASIC_AUTH
        default "ESP32Webserver"
        help
            The client's password which used for basic authenticate.

    config EXAMPLE_ENABLE_SSE_HANDLER
        bool "Enable Server-Sent Events (SSE) handler"
        default n
        help
            Enable this option to use Server-Sent Events (SSE) functionality.
            This will allow the server to push real-time updates to the client over an HTTP connection.

endmenu

menu "Vigilant Engine Configuration"

    config VE_ENABLE_STATUS_LED
        bool "Enable Status LED"
        default y
        help
            Enable this option to use the status LED functionality in Vigilant Engine.
            The status LED provides visual feedback on the system's status and operations, and can optionally be used for visual output.
    config VE_STATUS_LED_GPIO
        int "Status LED GPIO pin"
        default 8
        help
            The GPIO pin number for the status LED.

    config VE_ENABLE_PWM_LED
        bool "Enable PWM LED control"
        default y
        help
            Enable this option to drive a PWM LED from Vigilant Engine.
            When enabled, a PWM channel will be initialized and can be
            controlled via the web dashboard using WebSockets.

    config VE_PWM_GPIO
        int "PWM LED GPIO pin"
        depends on VE_ENABLE_PWM_LED
        default 2
        help
            The GPIO pin number for the PWM LED output.

    config VE_PWM_DEFAULT_FREQ
        int "PWM default frequency (Hz)"
        depends on VE_ENABLE_PWM_LED
        default 1000
        help
            The frequency in Hertz applied on boot before the dashboard
            overrides it. Values outside the hardware limits will be clamped.

    config VE_PWM_DEFAULT_DUTY
        int "PWM default duty cycle (%)"
        depends on VE_ENABLE_PWM_LED
        range 0 100
        default 50
        help
            The duty cycle percentage applied on boot before the dashboard
            overrides it.
        
endmenu
```
